/*
 * Copyright (c) 2020 The ZMK Contributors
 *
 * SPDX-License-Identifier: MIT
 */

#include <behaviors.dtsi>
#include <dt-bindings/zmk/keys.h>

#define HYP(x) LC(LA(LS(LG(x))))

/ {
    keymap {
        compatible = "zmk,keymap";
	/*
	SW1 -> 0,0
	SW2 -> 0,1
	SW3 -> 0,1 and 0,2
	SW4 -> 0,3
	SW5 -> 0,4 and 0,7 and 0,8
	SW6 -> 0,4
	SW7 -> 0,6
	SW8 -> 0,7
	SW9 -> 0,8
	*/

        default_layer {
            bindings = <
                &kp A
            >;
        };
    };
};

