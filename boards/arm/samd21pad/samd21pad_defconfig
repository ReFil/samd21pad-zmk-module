## boards/arm/samd21pad/samd21pad_defconfig
```kconfig
# SPDX-License-Identifier: Apache-2.0

CONFIG_ZMK_KEYBOARD_NAME="samd21pad"

CONFIG_SOC_SERIES_SAMD21=y
CONFIG_SOC_PART_NUMBER_SAMD21E18A=y
CONFIG_BOARD_SAMD21PAD=y
CONFIG_SOC_ATMEL_SAMD_OSC8M=y
CONFIG_SOC_ATMEL_SAMD_OSC8M_AS_MAIN=y
CONFIG_CORTEX_M_SYSTICK=y
CONFIG_PINCTRL=y
CONFIG_USE_DT_CODE_PARTITION=y
CONFIG_BOOTLOADER_BOSSA=y
CONFIG_BOOTLOADER_BOSSA_ADAFRUIT_UF2=y

CONFIG_BUILD_OUTPUT_UF2=y

CONFIG_FLASH=y
CONFIG_FLASH_PAGE_LAYOUT=y
CONFIG_FLASH_MAP=y
CONFIG_MPU_ALLOW_FLASH_WRITE=y

CONFIG_ZMK_BEHAVIORS_QUEUE_SIZE=11
CONFIG_SYSTEM_WORKQUEUE_STACK_SIZE=1536
CONFIG_ZMK_LOW_PRIORITY_THREAD_STACK_SIZE=256

CONFIG_TIMESLICING=n
CONFIG_MINIMAL_LIBC_MALLOC=n

CONFIG_NVS=y

CONFIG_SETTINGS=y
CONFIG_SETTINGS_NVS=y

CONFIG_ZMK_EXT_POWER=n
CONFIG_WS2812_STRIP=y
CONFIG_ZMK_RGB_UNDERGLOW=y
CONFIG_ZMK_RGB_UNDERGLOW_EXT_POWER=n
CONFIG_ZMK_RGB_UNDERGLOW_EFF_START=3
```
